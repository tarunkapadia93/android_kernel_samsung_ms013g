## arch/arm/configs/ms013g_defconfig
```kconfig
#variant defconfig
CONFIG_MACH_MS01_EUR_3G=y

# Qcom WLAN
CONFIG_WLAN=y

# Qualcomm Atheros Prima WLAN module
#
# CONFIG_PRIMA_WLAN is not set
CONFIG_PRONTO_WLAN=y
# CONFIG_PRIMA_WLAN_BTAMP is not set
CONFIG_PRIMA_WLAN_LFR=y
CONFIG_PRIMA_WLAN_OKC=y
CONFIG_PRIMA_WLAN_11AC_HIGH_TP=y
CONFIG_WLAN_FEATURE_11W=y
CONFIG_QCOM_VOWIFI_11R=y
```
